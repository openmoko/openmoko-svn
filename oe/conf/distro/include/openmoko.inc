## oe/conf/distro/include/openmoko.inc
```bitbake
#
# Header
#
DISTRO_NAME = "OpenMoKo"
DISTRO_VERSION = ".dev-snapshot-${SRCDATE}"
#DISTRO_TYPE = "release"
DISTRO_TYPE = "debug"

#
# Naming schemes
#
PARALLEL_INSTALL_MODULES = "1"
INHERIT += "debian multimachine"

#
# Packaging and output format
#
INHERIT += "package_ipk"
IMAGE_FSTYPES = "tar.gz ext2.gz jffs2"
IMAGE_FSTYPES_x86 = "tar.gz"
IMAGE_ROOTFS_SIZE_ext2 = "131072"

#
# Binutils & Compiler
#
PREFERRED_PROVIDERS += " virtual/${TARGET_PREFIX}gcc-initial:gcc-cross-initial"
PREFERRED_PROVIDERS += " virtual/${TARGET_PREFIX}gcc:gcc-cross"
PREFERRED_PROVIDERS += " virtual/${TARGET_PREFIX}g++:gcc-cross"

# EABI stuff
PREFERRED_PROVIDER_virtual/${TARGET_PREFIX}-libc-for-gcc = "glibc-intermediate"
PREFERRED_PROVIDER_virtual/arm-angstrom-linux-gnueabi-libc-for-gcc = "glibc-intermediate"
PREFERRED_PROVIDER_virtual/arm-linux-libc-for-gcc = "glibc-intermediate"

#
# Target OS & FPU system
# 
TARGET_OS = "linux"
TARGET_FPU_arm = "soft"
TARGET_FPU_armeb = "soft"
PREFERRED_PROVIDER_virtual/libiconv = "glibc"
PREFERRED_PROVIDER_virtual/libintl = "glibc"

#
# Features
#
DISTRO_FEATURES = "alsa bluetooth ext2 ipsec nfs ppp smbfs usbgadget"

#
# Bootstrap & Init
#
require conf/distro/include/sane-srcdates.inc

#
# Framebuffer & X
#
PREFERRED_PROVIDER_virtual/libx11 ?= "libx11"
PREFERRED_PROVIDER_virtual/ecore ?= "ecore-x11"
PREFERRED_PROVIDER_virtual/evas ?= "evas-x11"
PREFERRED_PROVIDER_virtual/esmart ?= "esmart-x11"
PREFERRED_PROVIDER_virtual/libsdl = "libsdl-x11"
PREFERRED_PROVIDER_virtual/xserver ?= "xserver-kdrive"
PREFERRED_PROVIDER_tslib ?= "tslib"
PREFERRED_PROVIDER_xserver ?= "xserver-kdrive"
require conf/distro/include/preferred-xorg-versions-X11R7.1.inc

#
# Opie
#
QTE_VERSION = "2.3.10"
PALMTOP_USE_MULTITHREADED_QTE = "yes"
require conf/distro/include/preferred-opie-versions.inc

#
# Enlightenment
#
require conf/distro/include/preferred-e-versions.inc

#
# Versions for OpenMoko
#
require conf/distro/include/preferred-openmoko-versions.inc
```

## oe/conf/distro/include/preferred-openmoko-versions.inc
```bitbake
#
# Specify which versions of OpenMoko packages to build
#

#
# Base
#

SRCDATE_uboot = "now"
SRCDATE_uboot-gta01 = "now"
SRCDATE_kernel = "now"
SRCDATE_gta01-kernel = "now"
SRCDATE_linux-gta01 = "now"
SRCDATE_linux-gta01-nobbt = "now"
SRCDATE_s3c2410-boot-usb-native = "now"
SRCDATE_sjf2410-linux-native = "now"
SRCDATE_dfu-util = "now"
SRCDATE_dfu-util-native = "now"
SRCDATE_fbgrab-viewer-native = "now"

SRCDATE_libgsmd = "now"
SRCDATE_openmoko-session = "now"
SRCDATE_openmoko-common = "now"
SRCDATE_openmoko-theme-standard = "now"
SRCDATE_openmoko-theme-standard-qvga = "now"
SRCDATE_openmoko-icon-theme-standard = "now"
SRCDATE_openmoko-sound-theme-standard = "now"
SRCDATE_openmoko-libs = "now"

#
# Input Methods
#
SRCDATE_openmoko-keyboard = "now"

#
# Examples
#
SRCDATE_openmoko-stylus-demo = "now"
SRCDATE_openmoko-stylus-demo-simple = "now"
SRCDATE_openmoko-finger-demo = "now"
SRCDATE_openmoko-panel-demo = "now"
SRCDATE_openmoko-panel-demo-simple = "now"

#
# PIM
#
SRCDATE_openmoko-contacts = "now"
SRCDATE_openmoko-dates = "now"
SRCDATE_openmoko-tasks = "now"
SRCDATE_openmoko-today = "now"
SRCDATE_openmoko-messages = "now"
SRCDATE_openmoko-rssreader = "now"

#
# Stylus Applications
#
SRCDATE_openmoko-appmanager = "now"
SRCDATE_openmoko-chordmaster = "now"
SRCDATE_openmoko-dialer = "now"
SRCDATE_openmoko-footer = "now"
SRCDATE_openmoko-phone = "now"
SRCDATE_openmoko-mainmenu = "now"
SRCDATE_openmoko-taskmanager = "now"
SRCDATE_openmoko-terminal = "now"

#
# Finger Applications
#
SRCDATE_openmoko-calculator = "now"

#
# Multimedia
#
SRCDATE_openmoko-simplemediaplayer = "now"

#
# Panel Plugins
#
SRCDATE_openmoko-panel-clock = "now"
SRCDATE_openmoko-panel-battery = "now"
SRCDATE_openmoko-panel-mainmenu = "now"
SRCDATE_openmoko-panel-gsm = "now"
SRCDATE_openmoko-panel-gps = "now"
SRCDATE_openmoko-panel-bt = "now"
SRCDATE_openmoko-panel-usb = "now"
```

## oe/conf/distro/openmoko-gcc3.conf
```bitbake
#-----------------------------------------------------------------------------
#@TYPE: Distribution
#@NAME: OpenMoKo
#@DESCRIPTION: Linux Distribution Configuration for the FIC GTA01 Project
#-----------------------------------------------------------------------------

#
# Header
#
DISTRO_NAME = "OpenMoKo"
DISTRO_VERSION = ".dev-snapshot-${DATE}-gcc3"
#DISTRO_TYPE = "release"
DISTRO_TYPE = "debug"

require conf/distro/include/openmoko.inc

PREFERRED_PROVIDERS += " virtual/${TARGET_PREFIX}libc-for-gcc:glibc"

# Toolchain
PREFERRED_VERSION_gcc ?= "3.4.4"
PREFERRED_VERSION_gcc-cross ?= "3.4.4"
PREFERRED_VERSION_gcc-cross-initial ?= "3.4.4"
PREFERRED_VERSION_binutils ?= "2.15.94.0.1"
PREFERRED_VERSION_binutils-cross ?= "2.15.94.0.1"
PREFERRED_VERSION_linux-libc-headers ?= "2.6.18"
PREFERRED_VERSION_glibc ?= "2.4"
PREFERRED_VERSION_glibc-intermediate ?= "2.4"
```

## oe/conf/distro/openmoko.conf
```bitbake
#-----------------------------------------------------------------------------
#@TYPE: Distribution
#@NAME: OpenMoKo
#@DESCRIPTION: Linux Distribution Configuration for the FIC GTA01 Project
#-----------------------------------------------------------------------------

#
# Header
#
DISTRO_NAME = "OpenMoKo"
DISTRO_VERSION = ".dev-snapshot-${SRCDATE}"
#DISTRO_TYPE = "release"
DISTRO_TYPE = "debug"

#
# Naming schemes
#
PARALLEL_INSTALL_MODULES = "1"
INHERIT += "debian multimachine"

#
# Packaging and output format
#
INHERIT += "package_ipk"
IMAGE_FSTYPES = "tar.gz ext2.gz jffs2"

#
# Binutils & Compiler
#
PREFERRED_PROVIDERS += " virtual/${TARGET_PREFIX}gcc-initial:gcc-cross-initial"
PREFERRED_PROVIDERS += " virtual/${TARGET_PREFIX}gcc:gcc-cross"
PREFERRED_PROVIDERS += " virtual/${TARGET_PREFIX}g++:gcc-cross"

# NOTE: 4.1.1 should be used eventually
PREFERRED_VERSION_gcc = "3.4.4"
PREFERRED_VERSION_gcc-cross = "3.4.4"
PREFERRED_VERSION_gcc-cross-initial = "3.4.4"
PREFERRED_VERSION_binutils-cross = "2.15.94.0.1"
PREFERRED_VERSION_binutils = "2.15.94.0.1"

#
# Target OS & FPU system
# 
TARGET_OS = "linux"
TARGET_FPU_arm = "soft"
TARGET_FPU_armeb = "soft"
PREFERRED_PROVIDER_virtual/libiconv = "glibc"
PREFERRED_PROVIDER_virtual/libintl = "glibc"
PREFERRED_VERSION_glibc = "2.3.5+cvs20050627"

#
# Features
#
DISTRO_FEATURES = "alsa bluetooth ext2 ipsec nfs ppp smbfs usbgadget"

#
# Bootstrap & Init
#
PREFERRED_PROVIDER_task-bootstrap = "task-bootstrap"
require conf/distro/include/sane-srcdates.inc

#
# Framebuffer & X
#
PREFERRED_PROVIDER_virtual/libx11 ?= "libx11"
PREFERRED_PROVIDER_virtual/ecore ?= "ecore-x11"
PREFERRED_PROVIDER_virtual/evas ?= "evas-x11"
PREFERRED_PROVIDER_virtual/esmart ?= "esmart-x11"
PREFERRED_PROVIDER_virtual/libsdl = "libsdl-x11"
PREFERRED_PROVIDER_virtual/xserver ?= "xserver-kdrive"
PREFERRED_PROVIDER_tslib ?= "tslib"
PREFERRED_PROVIDER_xserver ?= "xserver-kdrive"
PREFERRED_VERSION_xserver-kdrive = "1.1.0+git${SRCDATE}"
require conf/distro/include/preferred-xorg-versions-X11R7.1.inc

#
# Core System
#
PREFERRED_PROVIDER_dbus-glib = "dbus-glib"
PREFERRED_PROVIDER_gconf = "gconf-dbus"
PREFERRED_PROVIDER_gnome-vfs = "gnome-vfs-dbus"
PREFERRED_PROVIDER_bluez-utils = "bluez-utils-dbus"

#
# Opie
#
QTE_VERSION = "2.3.10"
PALMTOP_USE_MULTITHREADED_QTE = "yes"
require conf/distro/include/preferred-opie-versions.inc

#
# Enlightenment
#
require conf/distro/include/preferred-e-versions.inc

#
# Versions for OpenMoko
#
require conf/distro/include/preferred-openmoko-versions.inc
```

## oe/conf/machine/armzone-qt2410.conf
```bitbake
#-----------------------------------------------------------------------------
#@TYPE: Machine
#@NAME: armzone.com QT-2410
#@DESCRIPTION: Machine configuration for armzone.com QT-2410 Development Board
#-----------------------------------------------------------------------------

TARGET_ARCH = "arm"
IPKG_EXTRA_ARCHS = "armv4t"

PREFERRED_PROVIDER_virtual/kernel = "qt2410-kernel"

MACHINE_FEATURES = "kernel26 apm alsa bluetooth usbgadget"

MACHINE_EXTRA_RDEPENDS = ""
MACHINE_EXTRA_RRECOMMENDS = ""

MACHINE_TASK_PROVIDER = "task-base"

# used by sysvinit_2
SERIAL_CONSOLE = "-h 115200 ttySAC0"

# used by some images
ROOT_FLASH_SIZE = "60M"

# extra jffs2 tweaks
EXTRA_IMAGECMD_jffs2 = "--eraseblock=0x4000 --pad -n"

# build tools
EXTRA_IMAGEDEPENDS += "s3c2410-boot-usb-native sjf2410-linux-native"

# tune for S3C24x0
include conf/machine/include/tune-arm920t.conf
```

## oe/conf/machine/fic-gta01.conf
```bitbake
#-----------------------------------------------------------------------------
#@TYPE: Machine
#@NAME: FIC GTA01 (Neo1973)
#@DESCRIPTION: Machine configuration for the FIC Neo1973 GSM phone
#-----------------------------------------------------------------------------

TARGET_ARCH = "arm"
PACKAGE_EXTRA_ARCHS = "armv4t"

PREFERRED_PROVIDER_virtual/kernel = "linux-gta01"
PREFERRED_VERSION_linux-gta01 = "2.6.21.3"

MACHINE_FEATURES = "kernel26 apm alsa bluetooth usbgadget usbhost"

MACHINE_EXTRA_RDEPENDS = ""

# package gta01 specific modules
MACHINE_EXTRA_RRECOMMENDS = "\
  kernel-module-s3cmci  \
  kernel-module-gta01-pm-bt  \
  kernel-module-gta01-pm-gps \
  kernel-module-gta01-pm-gsm \
  kernel-module-snd-soc-neo1973-wm8753 \
  kernel-module-snd-soc-smdk2440 \
  kernel-module-vfat \
  kernel-module-nls-iso8859-1 \
  kernel-module-nls-cp437 \
  "

MACHINE_TASK_PROVIDER = "task-base"

# serial console entry is hardcoded in our inittab due to special GSM requirements
#SERIAL_CONSOLE = "115200 ttySAC0"

# used by some images
ROOT_FLASH_SIZE = "60M"

# extra jffs2 tweaks
EXTRA_IMAGECMD_jffs2 = "--eraseblock=0x4000 --pad -n"

# build tools
EXTRA_IMAGEDEPENDS += "sjf2410-linux-native openocd-native dfu-util-native"

# tune for S3C24x0
include conf/machine/include/tune-arm920t.conf
```

## oe/conf/machine/x86-sdk.conf
```bitbake
#-----------------------------------------------------------------------------
#@TYPE: Machine
#@NAME: x86-sdk
#@DESCRIPTION: Machine configuration for x86 SDK
#-----------------------------------------------------------------------------

TARGET_ARCH = "i386"
TARGET_VENDOR = "-oe"
IPKG_EXTRA_ARCHS = "x86"

PREFERRED_PROVIDER_virtual/kernel = "linux-x86"

MACHINE_FEATURES = "kernel26 apm alsa bluetooth usbgadget"

MACHINE_EXTRA_RDEPENDS = ""
MACHINE_EXTRA_RRECOMMENDS = ""

MACHINE_TASK_PROVIDER = "task-base"

# used by sysvinit_2
SERIAL_CONSOLE = "-h 115200 ttyS0"

# used by some images
ROOT_FLASH_SIZE = "60M"
# extra jffs2 tweaks
EXTRA_IMAGECMD_jffs2 = "--eraseblock=0x4000 --pad -n"

# build tools
EXTRA_IMAGEDEPENDS += "s3c2410-boot-usb-native sjf2410-linux-native"

udevdir = "/dev"
OLDEST_KERNEL = "2.6.5"
GLIBC_ADDONS = "nptl"
GLIBC_EXTRA_OECONF = "--with-tls"
```
