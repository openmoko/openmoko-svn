#
# Specify which versions of OpenMoko packages to build
#

#
# Base
#

SRCDATE_uboot = "now"
SRCDATE_uboot-gta01 = "now"
SRCDATE_kernel = "now"
SRCDATE_gta01-kernel = "now"
SRCDATE_linux-gta01 = "now"
SRCDATE_linux-gta01-nobbt = "now"
SRCDATE_s3c2410-boot-usb-native = "now"
SRCDATE_sjf2410-linux-native = "now"
SRCDATE_dfu-util = "now"
SRCDATE_dfu-util-native = "now"
SRCDATE_fbgrab-viewer-native = "now"

SRCDATE_libgsmd = "now"
SRCDATE_openmoko-session = "now"
SRCDATE_openmoko-common = "now"
SRCDATE_openmoko-theme-standard = "now"
SRCDATE_openmoko-theme-standard-qvga = "now"
SRCDATE_openmoko-icon-theme-standard = "now"
SRCDATE_openmoko-sound-theme-standard = "now"
SRCDATE_openmoko-libs = "now"

#
# Input Methods
#
SRCDATE_openmoko-keyboard = "now"

#
# Examples
#
SRCDATE_openmoko-stylus-demo = "now"
SRCDATE_openmoko-stylus-demo-simple = "now"
SRCDATE_openmoko-finger-demo = "now"
SRCDATE_openmoko-panel-demo = "now"
SRCDATE_openmoko-panel-demo-simple = "now"

#
# PIM
#
SRCDATE_openmoko-contacts = "now"
SRCDATE_openmoko-dates = "now"
SRCDATE_openmoko-tasks = "now"
SRCDATE_openmoko-today = "now"
SRCDATE_openmoko-messages = "now"
SRCDATE_openmoko-rssreader = "now"

#
# Stylus Applications
#
SRCDATE_openmoko-appmanager = "now"
SRCDATE_openmoko-chordmaster = "now"
SRCDATE_openmoko-dialer = "now"
SRCDATE_openmoko-footer = "now"
SRCDATE_openmoko-phone = "now"
SRCDATE_openmoko-mainmenu = "now"
SRCDATE_openmoko-taskmanager = "now"
SRCDATE_openmoko-terminal = "now"

#
# Finger Applications
#
SRCDATE_openmoko-calculator = "now"

#
# Multimedia
#
SRCDATE_openmoko-simplemediaplayer = "now"

#
# Panel Plugins
#
SRCDATE_openmoko-panel-clock = "now"
SRCDATE_openmoko-panel-battery = "now"
SRCDATE_openmoko-panel-mainmenu = "now"
SRCDATE_openmoko-panel-gsm = "now"
SRCDATE_openmoko-panel-gps = "now"
SRCDATE_openmoko-panel-bt = "now"
SRCDATE_openmoko-panel-usb = "now"
